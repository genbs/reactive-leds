## firmware/main/Kconfig.projbuild
```kconfig
menu "Device configuration"

    config LED_PIN
        int "GPIO for LED Strip"
        default 18
        range 0 48
        help
            The output GPIO connected to the LED strip (0..21 or 26..48).

    config NUM_LEDS
        int "Number of LEDs"
        default 16
        range 1 255
        help
            The total number of LEDs in the strip.

    config PORT
        int "UDP Listener Port"
        default 4210
        range 1024 65535
        help
            The UDP port the ESP32 will listen on for commands.

endmenu
```
